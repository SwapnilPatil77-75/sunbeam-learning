/dts-v1/;
/plugin/;

/ {
    compatible = "ti,beaglebone", "ti,am335x";

    fragment@0 {
        target = <&i2c2>;        // I2C2 bus on P9_19/P9_20
        __overlay__ {
            status = "okay";

            #address-cells = <1>;
            #size-cells = <0>;

            mpu6050: mpu6050@68 {
                compatible = "invensense,mpu6050";
                reg = <0x68>;
                status = "okay";
            };
        };
    };
};

